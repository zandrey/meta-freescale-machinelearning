## conf/layer.conf
```bitbake
# We have a conf and classes directory, add to BBPATH
BBPATH .= ":${LAYERDIR}"

# We have recipes-* directories, add to BBFILES
BBFILES += "${LAYERDIR}/recipes-*/*/*.bb \
	${LAYERDIR}/recipes-*/*/*.bbappend"

BBFILE_COLLECTIONS += "freescale-machinelearning"
BBFILE_PATTERN_freescale-machinelearning = "^${LAYERDIR}/"
BBFILE_PRIORITY_freescale-machinelearning = "9"
LAYERSERIES_COMPAT_freescale-machinelearning = "zeus"

LAYERDEPENDS_freescale-machinelearning = " \
    freescale-layer \
    fsl-arm-extra \
    fsl-demos \
    openembedded-layer \
    multimedia-layer \
    meta-python \
"
```
